## Documentation/devicetree/bindings/arm/exynos/system-mmu.txt
```
* Samsung Exynos System MMU

Samsung's Exynos architecture includes System MMU that enables scattered
physical chunks to be visible as a contiguous region to DMA-capabile peripheral
devices like MFC, FIMC, FIMD, GScaler, FIMC-IS and so forth.

System MMU is a sort of IOMMU and support identical translation table format to
ARMv7 translation tables with minimum set of page properties including access
permissions, shareability and security protection. In addition System MMU has
another capabilities like L2 TLB or block-fetch buffers to minimize translation
latency

Each System MMU is included in the H/W block of a peripheral device. Thus, it is
important to specify that a System MMU is dedicated to which peripheral device
before using System MMU. System initialization must specify the relationships
between a System MMU and a peripheral device that owns the System MMU.

Some device drivers may control several peripheral devices with a single device
descriptor like MFC. Since handling a System MMU with IOMMU API requires a
device descriptor that needs the System MMU, it is best to combine the System
MMUs of the peripheral devices and control them with a single System MMU device
descriptor. If it is unable to combine them into a single device descriptor,
they can be linked with each other by the means of device.parent relationship.

Required properties:
- compatible: Should be "samsung,exynos-sysmmu".
- reg: Tuples of base address and size of System MMU registers. The number of
       tuples can be more than one if two or more System MMUs are controlled
       by a single device descriptor.
- interrupt-parent: The phandle of the interrupt controller of System MMU
- interrupts: Tuples of numbers that indicates the interrupt source. The
              number of elements in the tuple is dependent upon
             'interrupt-parent' property. The number of tuples in this property
             must be the same with 'reg' property.

Optional properties:
- mmuname: Strings of the name of System MMU for debugging purpose. The number
          of strings must be the same with the number of tuples in 'reg'
          property.
- mmu-master: phandle to the device node that owns System MMU. Only the device
          that is specified whith this property can control System MMU with
          IOMMU API.

Examples:

MFC has 2 System MMUs for each port that MFC is attached. Thus it seems natural
to define 2 System MMUs for each port of the MFC:

	sysmmu-mfc-l {
		mmuname = "mfc_l";
		reg = <0x11210000 0x1000>;
		compatible = "samsung,exynos-sysmmu";
		interrupt-parent = <&combiner>;
		interrupts = <8 5>;
		mmu-master = <&mfc>;
	};

	sysmmu-mfc-r {
		mmuname = "mfc_r";
		reg = <0x11200000 0x1000>;
		compatible = "samsung,exynos-sysmmu";
		interrupt-parent = <&combiner>;
		interrupts = <6 2>;
		mmu-master = <&mfc>;
	};

Actually, MFC device driver requires sub-devices that represents each port and
above 'mmu-master' properties of sysmmu-mfc-l and sysmmu-mfc-r have the phandles
to those sub-devices.

However, it is also a good idea that treats the above System MMUs as one System
MMU because those System MMUs are actually required by the MFC device:

	sysmmu-mfc {
		mmuname = "mfc_l", "mfc_r";
		reg = <0x11210000 0x1000
		       0x11200000 0x1000>;
		compatible = "samsung,exynos-sysmmu";
		interrupt-parent = <&combiner>;
		interrupts = <8 5
			      6 2>;
		mmu-master = <&mfc>;
	};

If System MMU of MFC is defined like the above, the number of elements and the
order of list in 'mmuname', 'reg' and 'interrupts' must be the same.
```

## Documentation/devicetree/bindings/arm/exynos/tvmixer.txt
```
* Samsung video/graphics mixer and blender

Mixer blends graphics data from multiple sources and sends resulting
data to TVOUT module.


Required properties:

 - compatible : "samsung,s5pv210-tvmixer"
 - reg : shall contain memory addresses and sizes of mixer and video
   processor devices
 - reg-names : "mxr" for mixer's address/size and "vp" to for video
   processor's.
 - interrupt-names : shall contain "irq"


Example:

	tvmixer@12c10000 {
		compatible = "samsung,s5pv210-tvmixer";
		reg = <0x12c10000 0x10000>,
		      <0x12c00000 0x10000>;
		reg-names = "mxr", "vp";
		interrupts = <0 123 0>;
		interrupt-names = "irq";
	};
```

## Documentation/devicetree/bindings/arm/omap/usb-host.txt
```
* usb-host - OMAP USB Host Subsystem

The OMAP USB host subsystem consists of the following modules
1) USBTLL (Tranceiverless interface)
2) USBHOST (Host Controller module) which includes both EHCI and OHCI controllers

THe USB Host subsystem can be connected to the external world using 3 PORTs that could
be configured in various modes like  UTMI+ for external PHY, ULPI transceiverless link (TLL),
Serial TLL, High-speed interchip (HSIC), etc.

Required proprties:
- compatible: Must be "ti,usb-host";
- num_ports: Number of physical ports available

Optional properties:
- 1 child node for each available port.  These child nodes are usually supplied by the
  board support device tree as they are specific to how the ports are wired on the board

  - mode: Integer specifying the mode in which the port is used
	* OMAP_USBHS_PORT_MODE_UNUSED		= 0,
	* OMAP_EHCI_PORT_MODE_PHY		= 1,
	* OMAP_EHCI_PORT_MODE_TLL		= 2,
	* OMAP_EHCI_PORT_MODE_HSIC		= 3,
	* OMAP_OHCI_PORT_MODE_PHY_6PIN_DATSE0 	= 4,
	* OMAP_OHCI_PORT_MODE_PHY_6PIN_DPDM 	= 5,
	* OMAP_OHCI_PORT_MODE_PHY_3PIN_DATSE0	= 6,
	* OMAP_OHCI_PORT_MODE_PHY_4PIN_DPDM	= 7,
	* OMAP_OHCI_PORT_MODE_TLL_6PIN_DATSE0	= 8,
	* OMAP_OHCI_PORT_MODE_TLL_6PIN_DPDM	= 9,
	* OMAP_OHCI_PORT_MODE_TLL_3PIN_DATSE0	= 10,
	* OMAP_OHCI_PORT_MODE_TLL_4PIN_DPDM	= 11,
	* OMAP_OHCI_PORT_MODE_TLL_2PIN_DATSE0	= 12,
	* OMAP_OHCI_PORT_MODE_TLL_2PIN_DPDM	= 13,
   - clk: Name of the clock that needs to be active when using the port
   - clkrate: Frequency at which the above clk needs to be run at


Example:

/* In the OMAP Core tree */
usbhost: usb-host {
	compatible = "ti,usb-host";
	num_ports = <3>;
};

/* In the Board tree */
&usbhost {
	port@0 {
		mode = <1>;
		clk = "auxclk3_ck";
		clkrate = <19200000>;
	};
	port@1 {
		mode = <0>;
	};
	port@2 {
		mode = <0>;
	};
};
```

## Documentation/devicetree/bindings/arm/twd.txt
```
* ARM Timer Watchdog

ARM 11MP, Cortex-A5 and Cortex-A9 are often associated with a per-core
Timer-Watchdog (aka TWD), which provides both a per-cpu local timer
and watchdog.

The TWD is usually attached to a GIC to deliver its two per-processor
interrupts.

Main node required properties:

- compatible : Should be one of:
	"arm,cortex-a9-twd"
	"arm,cortex-a5-twd"
	"arm,arm11mp-twd"
	"arm,smp-twd"

- interrupts : Two interrupts to each core, the first one for the
  timer, the second one for the watchdog.

- reg : Specify the base address and the size of the TWD.

Example:

	twd@2c000600 {
		compatible = "arm,arm11mp-twd", "arm,smp-twd";
		reg = <0x2c000600 0x100>;
		interrupts = <1 13 0xf01 1 14 0xf01>;
	};
```

## Documentation/devicetree/bindings/i2c/sil-mhl9234.txt
```
* Silicon Image Mobile HD Link (MHL) 9234

Required properties :
 - compatible : "sil,mhl-9234"
 - reg        : i2c device address
 - gpio-reset : gpio line used to reset IC

Example:

	mhl@39 {
		compatible = "sil,mhl-9234";
		reg = <0x39>;
		gpio-reset = <&gpf3 4 0 0 0>;
	};
```

## Documentation/devicetree/bindings/lcd/lcd-pwrctrl.txt
```
* Power controller for simple lcd panels

Some LCD panels provide a simple control interface for the host system. The
control mechanism would include a nRESET line connected to a gpio of the host
system and a Vcc supply line which the host can optionally be controlled using
a voltage regulator. Such simple panels do not support serial command
interface (such as i2c or spi) or memory-mapped-io interface.

Required properties:
- compatible: should be 'lcd-powercontrol'

- lcd-reset-gpio: The GPIO number of the host system used to control the
  nRESET line. The format of the gpio specifier depends on the gpio controller
  of the host system.

Optional properties:
- lcd-reset-active-high: When the nRESET line is asserted low, the lcd panel
  is reset and stays in reset mode as long as the nRESET line is asserted low.
  This is the default behaviour of most lcd panels. If a lcd panel requires the
  nRESET line to be asserted high for panel reset, then this property is used.
  Note: Some platforms might allow inverting the polarity of the gpio output
  in the 'lcd-reset-gpio' gpio specifier. On such platforms, if the polarity
  is used to control the output of the gpio, then this property should not be
  used.

- vcc-lcd-supply: phandle of the regulator that controls the vcc supply to
  the lcd panel.

Example:

	lcd_pwrctrl {
		compatible = "lcd-powercontrol";
		lcd-reset-gpio = <&gpe0 4 1 0 0>;
		lcd-reset-active-high;
		lcd-vcc-supply = <&regulator7>;
	};
```

## Documentation/devicetree/bindings/sound/samsung-i2s.txt
```
* Samsung I2S controller

Required SoC Specific properties:

- compatible : "samsung,samsung-i2s"
- reg: physical base address of the controller and length of memory mapped
  region.
- tx-dma-channel-secondary: The dma channel specifier for secondary tx
  operations. The format of the dma specifier depends on the dma
  controller.
- tx-dma-channel: The dma channel specifier for tx operations. The format of
  the dma specifier depends on the dma controller.
- rx-dma-channel: The dma channel specifier for rx operations. The format of
  the dma specifier depends on the dma controller.
- supports-6ch: If the Primary DAI has 5.1 Channel support, this flag is
  enabled.
- supports-rstclr: This flag should be set if I2S software reset bit control is
  required. When this flag is set I2S software reset bit will be enabled or
  disabled based on need.
- supports-secdai: If the I2S block has a secondary sound source support, then
  this flag is enabled.

Required Board Specific Properties:

- gpios: The gpio specifier for data out,data in, LRCLK, CDCLK and SCLK
  interface lines. The format of the gpio specifier depends on the gpio
  controller.
- idma-addr: Internal DMA register base address of the audio sub system(used in
  secondary sound source).

Aliases:

- All the I2S controller nodes should be represented in the aliases node using
  the following format 'i2s{n}' where n is a unique number for the alias.

Example:

- SoC Specific Portion:

i2s@03830000 {
	compatible = "samsung,samsung-i2s";
	reg = <0x03830000 0x100>;
	tx-dma-channel-secondary = <&pdma0 8>;
	tx-dma-channel = <&pdma0 10>;
	rx-dma-channel = <&pdma0 9>;
	supports-6ch;
	supports-rstclr;
	supports-secdai;
};

- Board Specific Portion:

i2s_0: i2s@03830000 {
	gpios = <&gpz 0 2 0 0>,
		<&gpz 1 2 0 0>,
		<&gpz 2 2 0 0>,
		<&gpz 3 2 0 0>,
		<&gpz 4 2 0 0>,
		<&gpz 5 2 0 0>,
		<&gpz 6 2 0 0>;
	idma-addr = <0x03000000>;
};
```

## Documentation/devicetree/bindings/usb/exynos-usb.txt
```
Samsung Exynos SoC USB controller

The device node for USB controller for Samsung SOC have
following properties

OHCI
Required properties:
 - compatible: should be "samsung,exynos-ohci" for USB 2.0
   OHCI companion controller in host mode.
 - reg: physical base address of the controller and length
   of memory mapped.
 - interrupts: interrupt number to the cpu.

ohci {
	compatible = "samsung,exynos-ohci";
	reg = <0x12120000 0x100>;
	interrupts = <0 71 0>;
};
```

## Documentation/devicetree/bindings/usb/s3c-hsotg.txt
```
Samsung HSOTG controller s3c-hsotg

Required properties:
  - compatible : should be "samsung,exynos-hsotg".
  - reg : should contain at least address and length of the standard HSOTG
    register set for the device.
  - interrupts : one HSOTG interrupt should be described here.

Example (Samsung Origen):

	usb@12480000 {
		compatible = "samsung,exynos-hsotg";
		reg = <0x12480000 0x20000>;
		interrupts = <0 71 0>;
	};
```
